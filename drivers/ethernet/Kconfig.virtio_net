## drivers/ethernet/Kconfig.virtio_net
```kconfig
# ETH_VIRTIO_NET Ethernet driver configuration options

# Copyright (c) 2022 Huawei Technologies
# SPDX-License-Identifier: Apache-2.0

config VIRTIO_NET
	bool "VirtIO net driver"
	depends on VIRTIO
	default n
	select DYNAMIC_INTERRUPTS
	help
	  Build the VirtIO-net driver. Currently we only support this on virt (cortex A53).
	  It will bind the device to virtio-mmio bus 0 on QEMU.
```

## drivers/virtio/Kconfig
```kconfig
# Virtio driver configuration options

# Copyright (c) 2022 Huawei Technologies
# SPDX-License-Identifier: Apache-2.0

menuconfig VIRTIO
	bool "VirtIO drivers"
	help
	  Enable VirtIO drivers

if VIRTIO

module = VIRTIO
module-str = virtio
source "subsys/logging/Kconfig.template.log_config"

choice
	prompt "VirtIO transport layer"
	default VIRTIO_USE_MMIO

config VIRTIO_USE_MMIO
	bool "VirtIO with MMIO transport layer"
	help
	  Use MMIO as a transport layer for VirtIO. Recommended by the
	  standard for embedded devices

config VIRTIO_USE_PCI
	bool "VirtIO with PCI transport layer"
	help
	  Use PCI as a transport layer for VirtIO.
endchoice

endif
```

## dts/bindings/virtio/virtio,mmio.yaml
```yaml
# Copyright (c) 2022 Huawei Technologies
# SPDX-License-Identifier: Apache-2.0

description: VirtIO device properties

compatible: "virtio,mmio"

include: base.yaml

bus: virtio

properties:
    dma-coherent:
      type: boolean
    interrupts:
      required: true
    reg:
      required: true
    memory-region:
      type: phandle
      required: false
      default: &sram0

interrupt-cells:
  - type
  - irq
  - flags
  - priority
```
